## Kconfig
```kconfig
# SPDX-License-Identifier: MIT
# nanoMODBUS root Kconfig redirection
rsource "zephyr/Kconfig"
```

## dts/bindings/serial/nanomodbus,serial.yaml
```yaml
# Copyright (c) 2026 nanoMODBUS Contributors
# SPDX-License-Identifier: MIT

description: nanoMODBUS Serial RTU transport device

compatible: "nanomodbus,serial"

include:
  - uart-device.yaml
  - base.yaml

bus: modbus

properties:
  de-gpios:
    type: phandle-array
    description: RS-485 Driver Enable (DE) GPIO pin.

  re-gpios:
    type: phandle-array
    description: |
      RS-485 Receiver Enable (RE) GPIO pin.
      If connected directly the MCU pin should be configured as active low.

  de-pre-delay-us:
    type: int
    default: 0
    description: Guard time before TX with DE high in microseconds (GPIO mode).

  de-post-delay-us:
    type: int
    default: 0
    description: Guard time after TX before DE low in microseconds (GPIO mode).

  de-mode:
    type: string
    default: "auto"
    enum:
      - "auto"
      - "hardware"
      - "gpio"
      - "none"
    description: Driver-enable control strategy.

  rx-mode:
    type: string
    default: "auto"
    enum:
      - "auto"
      - "irq"
      - "async"
      - "external"
    description: Receive path selection.

  current-speed:
    type: int
    description: Baud rate in bits per second.

child-binding:
  description: Modbus child slave node
  properties:
    reg:
      type: int
      required: true
      description: Modbus slave ID / unit identifier.
```

## tests/zephyr/testcase.yaml
```yaml
tests:
  nanomodbus.baseline:
    tags: modbus
    platform_allow: native_sim
    integration_platforms:
      - native_sim
    extra_configs:
      - CONFIG_ZTEST=y
      - CONFIG_NANOMODBUS=y
      - CONFIG_NANOMODBUS_CLIENT=y
      - CONFIG_NANOMODBUS_SERVER=y
```

## zephyr/Kconfig
```kconfig
# SPDX-License-Identifier: MIT

menuconfig NANOMODBUS
	bool "nanoMODBUS support"
	help
	  Enable support for the nanoMODBUS compact Modbus RTU/TCP library.

if NANOMODBUS

module = NANOMODBUS
module-str = nanomodbus
source "subsys/logging/Kconfig.template.log_config"

config NANOMODBUS_DEBUG
	bool "Enable nanoMODBUS core debug prints"
	default n
	help
	  Defines NMBS_DEBUG, enabling stdout debug printing in nanomodbus core.

comment "Roles"

config NANOMODBUS_CLIENT
	bool "Enable Modbus Client (Master) role"
	default y
	help
	  Enables Modbus Client functionality and APIs.

config NANOMODBUS_SERVER
	bool "Enable Modbus Server (Slave) role"
	default y
	help
	  Enables Modbus Server functionality and request dispatching.

if NANOMODBUS_CLIENT

comment "Client Timeouts"

config NANOMODBUS_CLIENT_DEFAULT_READ_TIMEOUT_MS
	int "Default client response timeout (ms)"
	default 1000
	range 1 600000
	help
	  Time the client waits for the first byte of a response before
	  returning a timeout. Applied by nmbs_z_client_init(); can be changed
	  at runtime with nmbs_z_client_set_timeouts().

config NANOMODBUS_CLIENT_DEFAULT_BYTE_TIMEOUT_MS
	int "Default client inter-byte timeout (ms)"
	default 100
	range 1 600000
	help
	  Maximum gap between two bytes of a response. Applied by
	  nmbs_z_client_init(); can be changed at runtime with
	  nmbs_z_client_set_timeouts().

config NANOMODBUS_CLIENT_TCP_TIMEOUT_MS
	int "Default Modbus TCP client socket timeout (ms)"
	depends on NANOMODBUS_TRANSPORT_TCP
	default 5000
	range 1 600000
	help
	  Timeout used by nmbs_z_tcp_transport_connect() for the TCP
	  handshake and for the socket send/receive watchdog.

endif # NANOMODBUS_CLIENT

comment "Transports"

config NANOMODBUS_TRANSPORT_SERIAL
	bool "Enable Serial RTU Transport"
	depends on SERIAL
	default y
	help
	  Enables Modbus RTU communication over Zephyr UART devices.

config NANOMODBUS_TRANSPORT_TCP
	bool "Enable TCP Transport"
	depends on NET_SOCKETS && NET_TCP
	select NET_CONTEXT_RCVTIMEO
	select NET_CONTEXT_SNDTIMEO
	default n
	help
	  Enables Modbus TCP communication over Zephyr BSD Sockets.

config NANOMODBUS_SERIAL_RX_BUF_SIZE
	int "Serial RTU receive ring buffer size"
	depends on NANOMODBUS_TRANSPORT_SERIAL
	default 260
	range 256 1024
	help
	  Size of the internal buffer used to assemble incoming Modbus RTU
	  frames. A Modbus RTU ADU is at most 256 bytes, so values below 256
	  cannot hold a maximum-size frame.

config NANOMODBUS_SERIAL_ASYNC_RX_BUF_SIZE
	int "Serial RTU asynchronous RX buffer size"
	depends on NANOMODBUS_TRANSPORT_SERIAL
	default 128
	range 32 512
	help
	  Size of each of the two buffers handed to the asynchronous UART API
	  (DMA or interrupt backed) when NMBS_Z_SERIAL_RX_ASYNC is selected.

if NANOMODBUS_TRANSPORT_TCP

config NANOMODBUS_TCP_KEEPALIVE
	bool "Enable TCP keepalive on client transports"
	depends on NET_TCP_KEEPALIVE
	default n
	help
	  Enables SO_KEEPALIVE on sockets created by
	  nmbs_z_tcp_transport_connect() so that a peer that silently
	  disappeared is eventually reported as a transport error instead of
	  leaving the client blocked forever.

config NANOMODBUS_TCP_KEEPIDLE_S
	int "TCP keepalive idle time before the first probe (s)"
	depends on NANOMODBUS_TCP_KEEPALIVE
	default 60
	range 1 7200

config NANOMODBUS_TCP_KEEPINTVL_S
	int "TCP keepalive interval between probes (s)"
	depends on NANOMODBUS_TCP_KEEPALIVE
	default 10
	range 1 7200

config NANOMODBUS_TCP_KEEPCNT
	int "TCP keepalive probe count before dropping the connection"
	depends on NANOMODBUS_TCP_KEEPALIVE
	default 3
	range 1 100

endif # NANOMODBUS_TRANSPORT_TCP

comment "Server Engines"

config NANOMODBUS_SERVER_RTU
	bool "Enable Modbus RTU Server Engine"
	depends on NANOMODBUS_SERVER && NANOMODBUS_TRANSPORT_SERIAL
	default y
	help
	  Enables the event-driven RTU server engine with t3.5 character silence timer.

if NANOMODBUS_SERVER_RTU

config NANOMODBUS_SERVER_RTU_BYTE_TIMEOUT_MS
	int "RTU server inter-byte timeout (ms)"
	default 100
	range 1 10000
	help
	  Maximum gap between two bytes of a request. The RTU server uses the
	  same value for its first-byte read timeout and its byte timeout.

config NANOMODBUS_SERVER_RTU_WQ_STACK_SIZE
	int "RTU server workqueue stack size"
	default 1024
	range 512 8192
	help
	  Stack size in bytes for the per-instance RTU server workqueue thread.
	  The request is parsed on this thread, so it must be large enough for
	  the nanoMODBUS core plus the application callbacks.

config NANOMODBUS_SERVER_RTU_WQ_PRIORITY
	int "RTU server workqueue thread priority"
	default 5
	range -16 15
	help
	  Priority of the per-instance RTU server workqueue thread. It must be
	  preemptible, otherwise the t3.5 silence timer cannot interrupt it and
	  the response would stall the receive path.

endif # NANOMODBUS_SERVER_RTU

config NANOMODBUS_SERVER_TCP
	bool "Enable Modbus TCP Server Engine"
	depends on NANOMODBUS_SERVER && NANOMODBUS_TRANSPORT_TCP
	default n
	help
	  Enables the Modbus TCP server engine. The server accepts one client
	  at a time; additional connections wait in the listen backlog.

if NANOMODBUS_SERVER_TCP

config NANOMODBUS_SERVER_TCP_STACK_SIZE
	int "Modbus TCP Server thread stack size"
	default 2048
	help
	  Stack size in bytes for the dedicated Modbus TCP server listener thread.

config NANOMODBUS_SERVER_TCP_PRIORITY
	int "Modbus TCP Server thread priority"
	default 7
	help
	  Thread priority for the Modbus TCP server listener thread.

config NANOMODBUS_SERVER_TCP_TIMEOUT_MS
	int "Modbus TCP server idle poll timeout in milliseconds"
	default 200
	range 50 60000
	help
	  Time the TCP server waits for the first byte of a request before
	  cycling to check the connection and shutdown state. It is also used as
	  the inter-byte timeout for requests.

config NANOMODBUS_SERVER_TCP_BACKLOG
	int "Modbus TCP listen backlog"
	default 4
	range 1 16
	help
	  Number of pending client connections the network stack may queue.
	  The server still processes one accepted client at a time.

endif # NANOMODBUS_SERVER_TCP

comment "Buffer and Protocol Tuning"

config NANOMODBUS_BITFIELD_MAX
	int "Maximum bitfield size for coils and discrete inputs"
	default 2000
	range 8 2000
	help
	  Maximum number of coils or discrete inputs that can be addressed in a single
	  bitfield operation. Must be a multiple of 8.

menu "Function Code Memory Pruning"

config NANOMODBUS_FC_READ_COILS_DISABLED
	bool "Disable FC 01 (Read Coils)"
	default n

config NANOMODBUS_FC_READ_DISCRETE_INPUTS_DISABLED
	bool "Disable FC 02 (Read Discrete Inputs)"
	default n

config NANOMODBUS_FC_READ_HOLDING_REGISTERS_DISABLED
	bool "Disable FC 03 (Read Holding Registers)"
	default n

config NANOMODBUS_FC_READ_INPUT_REGISTERS_DISABLED
	bool "Disable FC 04 (Read Input Registers)"
	default n

config NANOMODBUS_FC_WRITE_SINGLE_COIL_DISABLED
	bool "Disable FC 05 (Write Single Coil)"
	default n

config NANOMODBUS_FC_WRITE_SINGLE_REGISTER_DISABLED
	bool "Disable FC 06 (Write Single Register)"
	default n

config NANOMODBUS_FC_WRITE_MULTIPLE_COILS_DISABLED
	bool "Disable FC 15 (Write Multiple Coils)"
	default n

config NANOMODBUS_FC_WRITE_MULTIPLE_REGISTERS_DISABLED
	bool "Disable FC 16 (Write Multiple Registers)"
	default n

config NANOMODBUS_FC_READ_FILE_RECORD_DISABLED
	bool "Disable FC 20 (Read File Record)"
	default y

config NANOMODBUS_FC_WRITE_FILE_RECORD_DISABLED
	bool "Disable FC 21 (Write File Record)"
	default y

config NANOMODBUS_FC_READ_WRITE_REGISTERS_DISABLED
	bool "Disable FC 23 (Read/Write Multiple Registers)"
	default y

config NANOMODBUS_FC_READ_DEVICE_IDENTIFICATION_DISABLED
	bool "Disable FC 43/14 (Read Device Identification)"
	default y

endmenu # Function Code Memory Pruning

endif # NANOMODBUS
```
