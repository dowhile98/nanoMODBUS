## CMakeLists.txt
```
cmake_minimum_required(VERSION 3.20.0)

list(APPEND ZEPHYR_EXTRA_MODULES ${CMAKE_CURRENT_SOURCE_DIR}/../..)

find_package(Zephyr REQUIRED HINTS $ENV{ZEPHYR_BASE})
project(nanomodbus_client_tcp)
target_sources(app PRIVATE src/main.c)
```

## Kconfig
```
# Copyright (c) 2026 nanoMODBUS Contributors
# SPDX-License-Identifier: MIT

mainmenu "nanoMODBUS TCP client sample"

config CLIENT_TCP_SERVER_IP
	string "Modbus TCP server address"
	default "192.168.1.10"
	help
	  IPv4 (or IPv6) address of the Modbus TCP server this sample connects to.

	  The board reaches the server over the network, so a loopback address
	  such as 127.0.0.1 would point back at the board itself. Set this to the
	  address of the host running the Modbus TCP server, for example:

	    west build -p always -b nucleo_h743zi samples/client_tcp \
	      -d build_client_tcp \
	      -- -DCONFIG_CLIENT_TCP_SERVER_IP='"192.168.1.50"'

config CLIENT_TCP_SERVER_PORT
	int "Modbus TCP server port"
	default 502
	range 1 65535
	help
	  TCP port of the Modbus TCP server. Use a port above 1024 when the server
	  runs as an unprivileged user on the host.

source "Kconfig.zephyr"
```

## prj.conf
```kconfig
CONFIG_NANOMODBUS=y
CONFIG_NANOMODBUS_CLIENT=y
CONFIG_NANOMODBUS_SERVER=n
CONFIG_NANOMODBUS_TRANSPORT_TCP=y
CONFIG_NETWORKING=y
CONFIG_NET_SOCKETS=y
CONFIG_NET_TCP=y
CONFIG_NET_IPV4=y
CONFIG_LOG=y

# main() owns the TCP client state in static storage; the extra headroom covers
# the socket call chain (connect/poll) on top of the logging calls.
CONFIG_MAIN_STACK_SIZE=2048
```

## boards/nucleo_h743zi.conf
```kconfig
# Copyright (c) 2026 nanoMODBUS Contributors
# SPDX-License-Identifier: MIT

CONFIG_NET_L2_ETHERNET=y
CONFIG_NET_DHCPV4=y
```

## src/main.c
```c
/*
 * Copyright (c) 2026 nanoMODBUS Contributors
 * SPDX-License-Identifier: MIT
 *
 * Modbus TCP client sample.
 *
 * The board takes an address over DHCP, then polls holding registers from the
 * server selected with CONFIG_CLIENT_TCP_SERVER_IP / CONFIG_CLIENT_TCP_SERVER_PORT.
 */

#include <zephyr/kernel.h>
#include <zephyr/logging/log.h>
#include <zephyr/nanomodbus/nanomodbus_z.h>
#include <zephyr/nanomodbus/nanomodbus_z_tcp.h>
#include <zephyr/net/dhcpv4.h>
#include <zephyr/net/net_if.h>
#include <zephyr/net/net_ip.h>
#include <zephyr/net/socket.h>

LOG_MODULE_REGISTER(client_tcp_app, CONFIG_NANOMODBUS_LOG_LEVEL);

#define SERVER_IP CONFIG_CLIENT_TCP_SERVER_IP
#define SERVER_PORT CONFIG_CLIENT_TCP_SERVER_PORT
#define POLL_INTERVAL_MS 1000
#define READ_QUANTITY 4

/*
 * The transport, client and platform configuration are kept in static storage.
 * Together they are close to 500 bytes; as main() locals they did not fit in
 * the default 1 KB main stack once the socket call chain was added, which
 * overflowed the stack on the first connect attempt.
 */
static nmbs_z_tcp_transport_t transport;
static nmbs_z_client_t client;
static nmbs_platform_conf platform;
static uint16_t registers[READ_QUANTITY];

static void log_ipv4_address(struct net_if* iface) {
    struct net_in_addr* addr = net_if_ipv4_get_global_addr(iface, NET_ADDR_PREFERRED);
    char buf[NET_IPV4_ADDR_LEN];

    if (addr == NULL || net_addr_ntop(NET_AF_INET, addr, buf, sizeof(buf)) == NULL) {
        return;
    }

    LOG_INF("Local address %s, connecting to %s:%d", buf, SERVER_IP, SERVER_PORT);
}

int main(void) {
    LOG_INF("nanoMODBUS TCP Client Sample Application Starting...");

    struct net_if* iface = net_if_get_default();

    if (iface == NULL) {
        LOG_ERR("No network interface available");
        return -ENODEV;
    }

    /* Request the lease explicitly instead of using CONFIG_NET_CONFIG_NEED_IPV4,
     * which blocks the whole application for up to 30 seconds at boot.
     */
    net_dhcpv4_start(iface);
    LOG_INF("Waiting for a DHCPv4 lease (carrier %s)", net_if_is_carrier_ok(iface) ? "up" : "down");

    int64_t last_wait_log = k_uptime_get();

    while (net_if_ipv4_get_global_addr(iface, NET_ADDR_PREFERRED) == NULL) {
        if (k_uptime_get() - last_wait_log >= 5000) {
            LOG_WRN("Still waiting for a DHCPv4 lease (carrier %s)", net_if_is_carrier_ok(iface) ? "up" : "down");
            last_wait_log = k_uptime_get();
        }

        k_sleep(K_MSEC(500));
    }

    log_ipv4_address(iface);

    bool connected = false;

    while (1) {
        if (!connected) {
            int ret = nmbs_z_tcp_transport_connect(&transport, SERVER_IP, SERVER_PORT,
                                                   CONFIG_NANOMODBUS_CLIENT_TCP_TIMEOUT_MS, &platform);
            if (ret != 0) {
                LOG_WRN("Connection to %s:%d failed (%d). Retrying in 2 seconds...", SERVER_IP, SERVER_PORT, ret);
                k_sleep(K_MSEC(2000));
                continue;
            }

            ret = nmbs_z_client_init(&client, &platform);
            if (ret != 0) {
                LOG_ERR("Failed to initialize client instance: %d", ret);
                nmbs_z_tcp_transport_close(&transport);
                k_sleep(K_MSEC(2000));
                continue;
            }

            LOG_INF("Connected to Modbus TCP server at %s:%d", SERVER_IP, SERVER_PORT);
            connected = true;
        }

        /* Poll holding registers */
        int ret = nmbs_z_client_read_holding_registers(&client, 0, READ_QUANTITY, registers, K_MSEC(1000));
        if (ret == 0) {
            LOG_INF("Polled Holding Registers [0..%u]: %u, %u, %u, %u", READ_QUANTITY - 1, registers[0], registers[1],
                    registers[2], registers[3]);
        }
        else {
            LOG_WRN("Polling failed (%d). Reconnecting...", ret);
            nmbs_z_tcp_transport_close(&transport);
            connected = false;
        }

        k_sleep(K_MSEC(POLL_INTERVAL_MS));
    }

    return 0;
}
```
